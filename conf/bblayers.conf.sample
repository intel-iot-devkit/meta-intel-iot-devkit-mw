## conf/bblayers.conf.sample
```bitbake
# LAYER_CONF_VERSION is increased each time build/conf/bblayers.conf
# changes incompatibly
LCONF_VERSION = "6"

BBPATH = "${TOPDIR}"
BBFILES ?= ""

BBLAYERS ?= " \
  ##OEROOT##/meta \
  ##OEROOT##/meta-oe \
  ##OEROOT##/meta-oe/meta-filesystems \
  ##OEROOT##/meta-eca \
  ##OEROOT##/meta-iot-devkit \
  ##OEROOT##/meta-yocto \
  ##OEROOT##/meta-quark-bsp \
  ##OEROOT##/meta-galileo \
  "
BBLAYERS_NON_REMOVABLE ?= " \
  ##OEROOT##/meta \
  ##OEROOT##/meta-yocto \
  "
```

## conf/distro/include/iot-devkit.inc
```bitbake
SANITY_TESTED_DISTROS = " \
            Ubuntu-14.04 \n \
            Fedora-20 \n \
            Debian-7.8 \n \
            openSUSE-project-13.1 \n \
            "

DISTRO_VERSION = "2.0"
DISTRO_CODENAME = "lemur"
DISTRO_NAME = "iot-devkit (Intel IoT Development Kit)"
MAINTAINER = "Intel IoT Devkit team <meta-intel@yoctoproject.org>"

# Changing these currently breaks the Eclipse plugin
#TARGET_VENDOR = "-iotkit"
#SDK_VENDOR = "-iotkit"

SSTATE_DIR ?= "${TOPDIR}/../devkit-cache/sstate-cache"
CACHE_forcevariable = "${TOPDIR}/../devkit-cache/cache"
PERSISTENT_DIR = "${TOPDIR}/../devkit-cache/persistent"
```

## conf/distro/iot-devkit-locked.conf
```bitbake
require conf/distro/iot-devkit.conf

PKGDATA_CACHE = "${CACHE}/packageinfo-iot-devkit-locked.dat"

require conf/distro/include/iot-devkit-locked-sigs.inc
```

## conf/distro/iot-devkit-spi-locked.conf
```bitbake
require conf/distro/iot-devkit-spi.conf

PKGDATA_CACHE = "${CACHE}/packageinfo-iot-devkit-spi-locked.dat"

require conf/distro/include/iot-devkit-spi-locked-sigs.inc
```

## conf/layer.conf
```bitbake
# We have a conf and classes directory, add to BBPATH
BBPATH := "${BBPATH}:${LAYERDIR}"

# We have a recipes directory, add to BBFILES
BBFILES := "${BBFILES} ${LAYERDIR}/recipes-*/*/*.bb \
	${LAYERDIR}/recipes-*/*/*.bbappend"

BBFILE_COLLECTIONS += "intel-iot-devkit-mw"
BBFILE_PATTERN_intel-iot-devkit-mw := "^${LAYERDIR}/"
BBFILE_PRIORITY_intel-iot-devkit-mw = "10"
```

## scripts/lib/image/canned-wks/iot-devkit.wks
```
# short-description: Create the iot-devkit disk image
# long-description: Creates the partitioned disk image that the user
# can directly dd to the sdcard.

part /boot --source iot-devkit --size 50 --ondisk mmcblkp0 --fstype=msdos --label msdos --active --align 1024

# this assumes that your SD card is 1GB+
part / --source rootfs --size 1000 --ondisk mmcblkp0 --fstype=ext3 --label platform --align 1024
```
